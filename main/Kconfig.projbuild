## sdkconfig.defaults
```kconfig
## ─── 编译优化（减小固件体积） ───
CONFIG_COMPILER_OPTIMIZATION_SIZE=y
CONFIG_COMPILER_OPTIMIZATION_ASSERTIONS_SILENT=y
CONFIG_COMPILER_OPTIMIZATION_CHECKS_SILENT=y
CONFIG_COMPILER_DISABLE_GCC14_WARNINGS=y

## ─── FreeRTOS 时钟频率（提高定时器精度） ───
## 默认 100 Hz 对 LVGL 不够精细，1000 Hz 提供 1ms 级 tick 精度
CONFIG_FREERTOS_HZ=1000
## 允许任务栈分配在 PSRAM（配合 esp_lvgl_adapter PSRAM 栈）
CONFIG_FREERTOS_TASK_CREATE_ALLOW_EXT_MEM=y

## ─── LVGL 跳过默认配置文件 ───
CONFIG_LV_CONF_SKIP=y

## ─── LVGL 颜色深度（1024×600 MIPI DSI 推荐 24-bit RGB888） ───
CONFIG_LV_COLOR_DEPTH_24=y

## ─── LVGL 默认字体 ───
CONFIG_LV_FONT_MONTSERRAT_14=y
CONFIG_LV_FONT_MONTSERRAT_16=y
CONFIG_LV_FONT_MONTSERRAT_20=y
CONFIG_LV_FONT_MONTSERRAT_22=y
CONFIG_LV_FONT_MONTSERRAT_24=y
CONFIG_LV_FONT_MONTSERRAT_26=y
CONFIG_LV_FONT_MONTSERRAT_32=y
CONFIG_LV_FONT_MONTSERRAT_36=y

## ─── LVGL CJK 中文字体（思源黑体） ───
CONFIG_LV_FONT_SOURCE_HAN_SANS_SC_14_CJK=y
CONFIG_LV_FONT_SOURCE_HAN_SANS_SC_16_CJK=y

## ─── FreeType 字体渲染（待 SD 卡驱动就绪后启用） ───
## CONFIG_LV_USE_FREETYPE=y
## CONFIG_ESP_LVGL_ADAPTER_ENABLE_FREETYPE=y

## ─── LVGL 操作系统集成（FreeRTOS） ───
CONFIG_LV_OS_FREERTOS=y

## ─── LVGL 使用标准 C 库函数（比 LVGL 内置实现更优化） ───
CONFIG_LV_USE_CLIB_MALLOC=y
CONFIG_LV_USE_CLIB_STRING=y
CONFIG_LV_USE_CLIB_SPRINTF=y

## ─── LVGL 显示刷新周期（20ms = 50 FPS，平衡流畅度与CPU负载） ───
CONFIG_LV_DEF_REFR_PERIOD=20

## ─── LVGL 对象样式缓存（减少重复样式计算，提升渲染性能） ───
CONFIG_LV_OBJ_STYLE_CACHE=y

## ─── LVGL 多核并行绘制（ESP32-P4 双核 RISC-V） ───
## 2 个绘制线程充分利用双核性能
CONFIG_LV_DRAW_SW_DRAW_UNIT_CNT=2

## ─── LVGL 调试工具（MVP 阶段用于性能分析） ───
CONFIG_LV_USE_OBSERVER=y
CONFIG_LV_USE_SYSMON=y
CONFIG_LV_USE_PERF_MONITOR=y

## ─── esp_lvgl_adapter 配置 ───
## FPS 统计（性能监控）
CONFIG_ESP_LVGL_ADAPTER_ENABLE_FPS_STATS=y
## LVGL 线程栈使用 PSRAM（32MB PSRAM 充足）
CONFIG_ESP_LVGL_ADAPTER_LVGL_THREAD_STACK_IN_PSRAM=y
## 局部防撕裂模式启用图片缓存优化
CONFIG_ESP_LVGL_ADAPTER_PARTIAL_AUX_IMG_CACHE=y
## 图片解码器 (esp_lv_decoder)：注册 PNG/JPEG/BMP/GIF/QOI 解码到 LVGL。
## 不开启则 lv_image_set_src("S:/emoji/xxx.png") 无法解码 → 图标显示空白。
## 适配器在 esp_lv_adapter start 时自动调 esp_lv_decoder_init()，
## 启动日志应出现 "Decoder initialized successfully"。
CONFIG_ESP_LVGL_ADAPTER_ENABLE_DECODER=y

## ─── esp_lcd_touch 配置 ───
## GT911 最大支持 5 点触摸
CONFIG_ESP_LCD_TOUCH_MAX_POINTS=5

## ─── PSRAM 缓存优化（ESP32-P4） ───
## ESP32-P4 封装内叠封 32MB PSRAM，启用 XIP + L2 Cache 加速访问
CONFIG_SPIRAM_XIP_FROM_PSRAM=y
CONFIG_CACHE_L2_CACHE_256KB=y
CONFIG_CACHE_L2_CACHE_LINE_128B=y

## ─── MIPI DSI 防撕裂模式（esp_lvgl_adapter tear-avoid） ───
## DOUBLE_DIRECT = MIPI DSI 默认推荐：2 帧缓冲 (~3.5 MB)，局部刷新
## 备选: NONE (1 帧 / ~1.8 MB), DOUBLE_FULL (2 帧), TRIPLE_* (3 帧 / ~5.3 MB)
CONFIG_SMARTBOX_LCD_RST_GPIO=-1
CONFIG_SMARTBOX_LCD_TEAR_AVOID_DOUBLE_DIRECT=y
CONFIG_SMARTBOX_LCD_ROTATE_0=y

## ─── ESP-IDF 实验性功能（ESP32-P4 MIPI DSI 需要） ───
CONFIG_IDF_EXPERIMENTAL_FEATURES=y

## ─── 自定义分区表 ───
CONFIG_PARTITION_TABLE_CUSTOM=y
CONFIG_PARTITION_TABLE_CUSTOM_FILENAME="partitions.csv"

## ─── I2C 驱动（GT911 触摸屏需要） ───
CONFIG_I2C_MASTER_ISR_IRAM_SAFE=n

## ─── 摄像头（OV5640 MIPI CSI） ───
CONFIG_CAMERA_OV5647=y

## ─── FatFS 配置 ───
CONFIG_FATFS_VFS_FSTAT_BLKSIZE=4096
CONFIG_FATFS_LFN_HEAP=y
CONFIG_FATFS_MAX_LFN=64

## ─── Wi-Fi Remote: ESP32-P4 ↔ ESP32-C6 over SDIO (Hosted mode) ───
CONFIG_SMARTBOX_WIFI_ENABLED=y
CONFIG_ESP_WIFI_REMOTE_ENABLED=y
CONFIG_ESP_WIFI_REMOTE_LIBRARY_HOSTED=y
CONFIG_SLAVE_IDF_TARGET_ESP32C6=y

## ─── WiFi 自动连接配置 ───
CONFIG_SMARTBOX_WIFI_AUTO_CONNECT=y
CONFIG_SMARTBOX_WIFI_SSID="iqoo"
CONFIG_SMARTBOX_WIFI_PASSWORD="12345678"

## ─── mbedTLS 配置 (参考 esp-video / esp-iot-solution) ───
## PSRAM 给 mbedTLS 用 (内部 RAM 留给 SDIO/AES DMA)
CONFIG_MBEDTLS_EXTERNAL_MEM_ALLOC=y
CONFIG_MBEDTLS_DYNAMIC_BUFFER=y
## SSL 缓冲: 参考工程 16KB 入 / 4KB 出 (默认 8K/2K 在高负载不稳定)
CONFIG_MBEDTLS_SSL_IN_CONTENT_LEN=16384
CONFIG_MBEDTLS_SSL_OUT_CONTENT_LEN=4096
CONFIG_MBEDTLS_CLIENT_SSL_SESSION_TICKETS=y
## TLS 1.3 关闭 — 与 MBEDTLS_DYNAMIC_BUFFER 同开时, 服务器(ark.cn-beijing.volces.com)
## 协商到 TLS 1.3 会在握手期(ssl_tls13_process_encrypted_extensions)缓冲管理错乱,
## pbuf payload 变野指针 → pbuf_copy_partial memcpy → Load access fault 崩溃。
## 实测回溯(2026-07-10)精确落在 TLS1.3 握手 + esp_mbedtls_free_tx_buffer。
## 强制走 TLS 1.2(大厂 API 全支持), 保留动态缓冲省 RAM。
# CONFIG_MBEDTLS_SSL_PROTO_TLS1_3 is not set
## 硬件 AES 必须开 — 参考工程全部启用, 纯软件 AES 并无帮助且明显拖慢

## ─── LLM API Key (替换为你的 Key，或通过 `idf.py menuconfig` 设置) ───
CONFIG_SMARTBOX_LLM_API_KEY=""

## ─── Flash 模式 (与 wifi_scan 验证配置一致) ───
CONFIG_ESPTOOLPY_FLASHMODE_QIO=y

## ─── app_main 任务栈大小 (LCD 初始化序列需要足够空间) ───
## 默认 3584 不够，wifi_scan 验证使用 12288
CONFIG_ESP_MAIN_TASK_STACK_SIZE=12288

## ─── 系统事件任务栈 (WiFi 回调链 + lv_async_call，默认 2304 不够) ───
CONFIG_ESP_SYSTEM_EVENT_TASK_STACK_SIZE=4096

## ─── MIPI DSI 通道速率 (与 wifi_scan 验证配置一致) ───
## DOTCLK=51.2MHz, MIPI_CLK=307MHz → lane bit rate=614Mbps
CONFIG_SMARTBOX_MIPI_DSI_LANE_BITRATE_MBPS=614

## SDIO Slot 1 pin mapping (P4 side) — 与官方 JC-ESP32P4-M3-DEV Demo 一致
CONFIG_ESP_HOSTED_SDIO_SLOT_1=y
CONFIG_ESP_HOSTED_SDIO_GPIO_RESET_SLAVE=54
CONFIG_ESP_HOSTED_PRIV_SDIO_PIN_CMD_SLOT_1=19
CONFIG_ESP_HOSTED_PRIV_SDIO_PIN_CLK_SLOT_1=18
CONFIG_ESP_HOSTED_PRIV_SDIO_PIN_D0_SLOT_1=14
CONFIG_ESP_HOSTED_PRIV_SDIO_PIN_D1_4BIT_BUS_SLOT_1=15
CONFIG_ESP_HOSTED_PRIV_SDIO_PIN_D2_4BIT_BUS_SLOT_1=16
CONFIG_ESP_HOSTED_PRIV_SDIO_PIN_D3_4BIT_BUS_SLOT_1=17

## SDIO 4-bit bus mode @ 40MHz
CONFIG_ESP_HOSTED_SDIO_4BIT_BUS_WIDTH=y
CONFIG_ESP_HOSTED_SDIO_CLOCK_FREQ_KHZ=40000
CONFIG_ESP_SDIO_CLOCK_FREQ_KHZ=40000

## Wi-Fi remote buffer config (对齐 esp-video / esp-iot-solution 参考工程)
## 大缓冲 + 大批次 AMPDU → 更少 SDIO 事务 → 更低竞态概率
CONFIG_WIFI_RMT_STATIC_RX_BUFFER_NUM=10
CONFIG_WIFI_RMT_DYNAMIC_RX_BUFFER_NUM=64
CONFIG_WIFI_RMT_DYNAMIC_TX_BUFFER_NUM=64
# CONFIG_WIFI_RMT_AMPDU_TX_ENABLED is not set
# CONFIG_WIFI_RMT_TX_BA_WIN=32
# CONFIG_WIFI_RMT_AMPDU_RX_ENABLED is not set
# CONFIG_WIFI_RMT_RX_BA_WIN=32
CONFIG_WIFI_RMT_NVS_ENABLED=y

## ── 内部 RAM 优化 ──
# CONFIG_ESP_HOSTED_CLI_ENABLED is not set
# CONFIG_ESP_HOSTED_MEM_MONITOR is not set
# CONFIG_ESP_HOSTED_ENABLE_ITWT is not set
CONFIG_ESP_HOSTED_SDIO_TX_Q_SIZE=20
CONFIG_ESP_HOSTED_SDIO_RX_Q_SIZE=20
CONFIG_ESP_HOSTED_MEMPOOL_PREFER_SPIRAM=y

## ── SDIO 错误恢复策略: 整机重启 ──
## SDIO 写重试 MAX_SDIO_WRITE_RETRY(=2) 次仍失败(258) → esp_hosted 判 "Unrecoverable
## host sdio state" → _h_restart_host() = esp_restart() 整机有序重启 (SW_CPU_RESET)。
## 优雅恢复(不重启方案)已实测失败: C6 重新握手不稳定, 有概率卡在 GPIO 复位 ~60s → 终归
## 落到 esp_restart 兜底, 而 back-to-back deinit/init 还破坏稳定性 → 无限循环; 退回干净重启
## 方案 100% 可靠, 每次 258 一次干净重启(~20s), 无卡死无循环。
## 注: TRANSPORT_FAILURE 事件无论此开关都会发(Kconfig 明确说明)。
CONFIG_ESP_HOSTED_TRANSPORT_RESTART_ON_FAILURE=y
CONFIG_SPIRAM_TRY_ALLOCATE_WIFI_LWIP=y

## ── LWIP TCP 性能 (平衡 SDIO 中转压力) ──
## C6 从机 TCP 窗口为 11520。P4 接收窗口过大 → 服务器爆发式发包 → C6 高速下行 +
## P4 回 ACK 上行写并发 → C6 SDIO 从机忙不过来不应答 → 258。
## 故接收窗口(WND)取小于 C6 窗口, 节流下行、给 C6 从容应答上行写的余地。
## 实测(2026-07-10): AI 推理模型长流式在 24576 窗口下近乎必现 258, 缩到 5760(4×MSS)节流下行。
## SND_BUF 保持 24576 不动 —— 上传(OCR JPEG)需要吞吐, 且 258 此处由下行触发。
CONFIG_LWIP_TCP_SND_BUF_DEFAULT=24576
CONFIG_LWIP_TCP_WND_DEFAULT=5760
CONFIG_LWIP_TCP_RECVMBOX_SIZE=64
CONFIG_LWIP_TCPIP_RECVMBOX_SIZE=64
CONFIG_LWIP_TCP_SACK_OUT=y
CONFIG_LWIP_TCP_HIGH_SPEED_RETRANSMISSION=y

## ── TCP TIME_WAIT 快速回收 ──
## HTTPS 请求完成后 TCP 进入 TIME_WAIT, 默认 60 秒内 C6 需维持连接状态。
## 连续多次 AI 对话时, 多个 TIME_WAIT 积压 → C6 RAM 不足 → SDIO 258。
## 降到 5 秒: 连接快速释放, 减少并发压力
CONFIG_LWIP_TCP_MSL=5000
CONFIG_LWIP_TCP_FIN_WAIT_TIMEOUT=5000

## ── LVGL 文件系统 (从 TF 卡读取字体/图标) ──
## 启用 POSIX FS 驱动，盘符 S: 映射到 /sdcard，以便 lv_binfont_create("S:/fonts/fontcn12.bin")
## 和 lv_image_set_src("S:/emoji/机器人-128x128.png") 能正常读取 SD 卡文件。
CONFIG_LV_USE_FS_POSIX=y
CONFIG_LV_FS_POSIX_LETTER=83
CONFIG_LV_FS_POSIX_PATH="/sdcard"
CONFIG_LV_FS_POSIX_CACHE_SIZE=4096

## MEMFS 驱动 — lv_binfont_create_from_buffer() 需要（从 PSRAM 缓冲解析字体，避免 SD 小读慢）
CONFIG_LV_USE_FS_MEMFS=y
CONFIG_LV_FS_MEMFS_LETTER=77

## ── 大字体支持（必须，否则 CJK 字体撕裂）──
## CJK 字体 ~2万字形，glyph 数据偏移量超 16 位。不开此项 LVGL 用 16 位读偏移，
## 靠后的汉字偏移量溢出回绕 → 读到错误位图 → 撕裂/错位。
CONFIG_LV_FONT_FMT_TXT_LARGE=y

## ── FatFS 中文文件名支持（图标 emoji 用中文名）──
## 默认代码页 437(美国)+ ANSI/OEM 编码无法匹配中文文件名，stat() 找不到文件。
## 改用 UTF-8 API 编码 + 代码页 936(GBK) 即可读取「机器人-128x128.png」等中文名。
CONFIG_FATFS_CODEPAGE_936=y
CONFIG_FATFS_API_ENCODING_UTF_8=y
```

## sdkconfig.defaults.esp32p4
```kconfig
CONFIG_ESP32P4_REV_MIN_0=y
# CONFIG_ESP32P4_REV_MIN_301 is not set

CONFIG_SPIRAM=y
CONFIG_SPIRAM_MODE_HEX=y
CONFIG_SPIRAM_SPEED_200M=y

CONFIG_ESPTOOLPY_FLASHSIZE_16MB=y

CONFIG_LV_DRAW_THREAD_STACK_SIZE=49152

CONFIG_ESP_WIFI_REMOTE_ENABLED=y
CONFIG_ESP_HOSTED_ENABLED=y

# CONFIG_SPIRAM_FETCH_INSTRUCTIONS is not set
# CONFIG_SPIRAM_RODATA is not set
# CONFIG_SPIRAM_XIP_FROM_PSRAM is not set
# CONFIG_SPIRAM_FLASH_LOAD_TO_PSRAM is not set

CONFIG_ESP_HOSTED_SDIO_CLOCK_FREQ_KHZ=20000
CONFIG_ESP_SDIO_CLOCK_FREQ_KHZ=20000
```
